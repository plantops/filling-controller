## firmware/esp32-s3/Kconfig.projbuild
```kconfig
menu "SP01 Filling Controller"

config SP01_CONTROL_PERIOD_MS
    int "Control period (ms)"
    range 2 100
    default 10

config SP01_TARGET_G
    int "Target weight (g)"
    range 1000 100000
    default 50000

config SP01_COARSE_TO_FINE_G
    int "Coarse-to-fine threshold (g)"
    range 1000 100000
    default 40000

config SP01_CUTOFF_MARGIN_G
    int "Cutoff margin below target (g)"
    range 0 5000
    default 0

config SP01_WEIGHT_STALE_MS
    int "Maximum weight age (ms)"
    range 20 5000
    default 500

config SP01_BAG_ACQUIRE_TIMEOUT_MS
    int "Bag acquire timeout (ms)"
    range 100 30000
    default 2000

config SP01_COARSE_TIMEOUT_MS
    int "Coarse fill timeout (ms)"
    range 500 30000
    default 12000

config SP01_FINE_TIMEOUT_MS
    int "Fine fill timeout (ms)"
    range 100 30000
    default 5000

config SP01_SETTLE_MIN_MS
    int "Minimum settle time (ms)"
    range 0 10000
    default 200

config SP01_WAIT_PUSH_TIMEOUT_MS
    int "Wait push-position timeout (ms)"
    range 100 30000
    default 6000

config SP01_PUSH_DURATION_MS
    int "Push output duration (ms)"
    range 50 5000
    default 500

config SP01_DI_INVERT_MASK
    hex "DI invert mask"
    range 0x00 0xFF
    default 0x00

config SP01_DO_INVERT_MASK
    hex "DO invert mask"
    range 0x00 0xFF
    default 0x00

config SP01_TLB_ENABLE
    bool "Enable TLB485 polling"
    default y

config SP01_TLB_BAUD
    int "TLB485 baud"
    default 9600

config SP01_TLB_SLAVE
    int "TLB485 Modbus address"
    range 1 99
    default 1

config SP01_TLB_POLL_MS
    int "TLB485 poll period (ms)"
    range 20 1000
    default 50

config SP01_TLB_CALIBRATION_WRITES
    bool "Enable TLB calibration writes from service HMI"
    default n
    help
        Enable only after the exact installed TLB485 protocol/manual revision has
        been checked. The UI additionally requires DI8 service enable and machine
        permissive OFF.

config SP01_WIFI_SSID
    string "Dedicated Wi-Fi SSID"
    default ""

config SP01_WIFI_PASSWORD
    string "Dedicated Wi-Fi password"
    default ""

config SP01_SERVICE_TOKEN
    string "Service token for calibration writes"
    default ""
    help
        No default token. If empty, calibration HTTP writes are rejected.

endmenu
```

## firmware/esp32-s3/main/Kconfig.projbuild
```kconfig
menu "SP01 Filling Controller"

config SP01_CONTROL_PERIOD_MS
    int "Control period (ms)"
    range 2 100
    default 10

config SP01_TARGET_G
    int "Target weight (g)"
    range 1000 100000
    default 50000

config SP01_COARSE_TO_FINE_G
    int "Coarse-to-fine threshold (g)"
    range 1000 100000
    default 40000

config SP01_CUTOFF_MARGIN_G
    int "Cutoff margin below target (g)"
    range 0 5000
    default 0

config SP01_BROKEN_BAG_LOSS_TRIP_G
    int "Broken-bag net-weight loss trip (g; 0 disables)"
    range 0 10000
    default 0
    help
        Production value must come from measured G4/G8 TLB and machine traces.
        Leave 0 until commissioning evidence freezes the detector threshold.

config SP01_BROKEN_BAG_PERSIST_MS
    int "Broken-bag loss persistence (ms; 0 disables)"
    range 0 5000
    default 0
    help
        Production value must come from measured G4/G8 evidence. The detector
        is disabled unless loss trip, persistence and reject-wait timeout are
        all non-zero.

config SP01_REJECT_WAIT_TIMEOUT_MS
    int "Reject-window wait timeout (ms; 0 disables detector)"
    range 0 30000
    default 0
    help
        Bounds REJECT_WAIT if the commissioned reject-position event is absent.
        Production value must be frozen from G8 timing evidence. Do not enable
        the broken-bag detector without a non-zero bounded timeout.

config SP01_WEIGHT_STALE_MS
    int "Maximum weight age (ms)"
    range 20 5000
    default 500

config SP01_BAG_ACQUIRE_TIMEOUT_MS
    int "Bag acquire timeout (ms)"
    range 100 30000
    default 2000

config SP01_COARSE_TIMEOUT_MS
    int "Coarse fill timeout (ms)"
    range 500 30000
    default 12000

config SP01_FINE_TIMEOUT_MS
    int "Fine fill timeout (ms)"
    range 100 30000
    default 5000

config SP01_SETTLE_MIN_MS
    int "Minimum settle time (ms)"
    range 0 10000
    default 200

config SP01_WAIT_DISCHARGE_TIMEOUT_MS
    int "Wait discharge-reference timeout (ms)"
    range 100 30000
    default 6000

config SP01_PUSH_DURATION_MS
    int "Push output duration (ms)"
    range 50 5000
    default 500

config SP01_DISCHARGE_COUNTDOWN_COUNTS
    int "Normalized post-ref-B discharge countdown"
    range 1 10000
    default 1000
    help
        A-to-B travel is normalized to 1000 counts. This value defines the
        nominal post-B countdown before bag push.

config SP01_DISCHARGE_LEAD_COUNTS
    int "Discharge lead trim (normalized counts)"
    range 0 9999
    default 0
    help
        Subtracted from SP01_DISCHARGE_COUNTDOWN_COUNTS. Commission from
        measured sensor geometry and actuator response; do not guess in field.

config SP01_DI_INVERT_MASK
    hex "DI invert mask"
    range 0x00 0xFF
    default 0x00

config SP01_DO_INVERT_MASK
    hex "DO invert mask"
    range 0x00 0xFF
    default 0x00

config SP01_TLB_ENABLE
    bool "Enable TLB485 polling"
    default y

config SP01_DUMMY_WEIGHT_ENABLE
    bool "Use dummy WeightSnapshot source (prototype shadow only)"
    default n
    help
        Temporary field-prototype source when the TLB485 is not yet available.
        It injects a simple 0 -> coarse -> fine -> target weight trajectory at
        the WeightSnapshot boundary. While enabled, normal process outputs are
        forced safe OFF. This does not replace G4/G5 real TLB/calibration work.

config SP01_TLB_BAUD
    int "TLB485 baud"
    default 9600
    help
        Conservative G4 bring-up default is 9600 bit/s. After the installed
        TLB485 and RS485 link are measured clean, the intended high-rate
        operating profile is 115200 bit/s. TLB and ESP settings must match.

config SP01_TLB_SLAVE
    int "TLB485 Modbus address"
    range 1 99
    default 1

config SP01_TLB_POLL_MS
    int "TLB485 poll period (ms)"
    range 10 1000
    default 50
    help
        Conservative G4 bring-up default is 50 ms. After measured latency,
        jitter and error-rate evidence, target 20 ms (~50 updates/s) at
        115200 bit/s. 10 ms is test-only and should not be selected merely
        to maximize update frequency.

config SP01_TLB_CALIBRATION_WRITES
    bool "Enable TLB calibration writes from service HMI"
    default n
    help
        Enable only after the exact installed TLB485 protocol/manual revision
        has been checked. Runtime interlocks still require machine stopped,
        fill switch OFF, outputs safe, healthy fresh stable weight, and service token.

config SP01_WIFI_SSID
    string "Dedicated Wi-Fi SSID"
    default ""

config SP01_WIFI_PASSWORD
    string "Dedicated Wi-Fi password"
    default ""

config SP01_SERVICE_TOKEN
    string "Service token for calibration writes"
    default ""
    help
        No default token. If empty, calibration HTTP writes are rejected.

config SP01_BENCH_DO_TEST_ENABLE
    bool "Enable G2 bench-only DO pulse test"
    default n
    help
        Exposes a one-output-at-a-time, auto-off pulse command on the local HMI.
        This exists only for disconnected bench validation of DO1..DO8. Never
        use it with machine actuators, solenoids or contactors connected.

config SP01_VIRTUAL_IO
    bool "Enable virtual I/O with web UI (bench only)"
    default n
    help
        Substitutes browser-driven virtual channels for physical DI and DO so
        controller logic can be exercised with no dry contacts, lamps or 24 V
        supply. While enabled, the TCA9554 is written to its safe latch once at
        startup and never written again: a virtual DO drives no pin.

        Bench and remote-development use only. Never enable on a node connected
        to machine wiring.

endmenu
```
